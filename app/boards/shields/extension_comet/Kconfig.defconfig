## app/boards/shields/extension_comet/Kconfig.defconfig
```kconfig
if SHIELD_EXTENSION_COMET
config ZMK_KEYBOARD_NAME
    default "CmtKExt"
config ZMK_USB
    default y
endif
```

## app/zmk/zephyr/soc/arm/nxp_mcx/mcx_a1xx/Kconfig.soc
```kconfig
# SPDX-License-Identifier: Apache-2.0

config SOC_SERIES_MCX_A1X
    bool "NXP MCX A1X Series MCU"
```

## west.yml
```yaml
manifest:
  remotes:
    - name: AnirudhaDG
      url-base: https://github.com/AnirudhaDG
  projects:
    - name: zmk-keyboard-CmtKExt
      remote: AnirudhaDG
```
